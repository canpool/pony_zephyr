## CMakeLists.txt
```
# Copyright (c) 2025 maminjie <canpool@163.com>
# SPDX-License-Identifier: Apache-2.0

cmake_minimum_required(VERSION 3.20.0)

find_package(Zephyr REQUIRED HINTS $ENV{ZEPHYR_BASE})
project(quickjs_hello)

target_sources(app PRIVATE src/main.c)
```

## sample.yaml
```
sample:
  description: Hello quickjs sample
  name: hello world
common:
  min_ram: 2
  min_flash: 16
  tags: introduction
  integration_platforms:
    - native_sim
  harness: console
  harness_config:
    type: one_line
    regex:
      - "Hello World! (.*)"
tests:
  sample.basic.helloworld:
    tags: introduction
```

## prj.conf
```kconfig
CONFIG_MAIN_STACK_SIZE=4096
CONFIG_LOG=y

CONFIG_QUICKJS=y
```

## src/main.c
```c
/*
 * Copyright (c) 2025 maminjie <canpool@163.com>
 *
 * SPDX-License-Identifier: Apache-2.0
 */

#include <zephyr/kernel.h>
#include <zephyr/sys/printk.h>
#include <quickjs.h>

int main(void)
{
	JSRuntime *rt;
	JSContext *ctx;
	JSValue result;
	const char *script = "1 + 2 * 3";

	printk("Starting QuickJS demo...\n");

	rt = JS_NewRuntime();
	ctx = JS_NewContext(rt);

	result = JS_Eval(ctx, script, strlen(script), "<inline>", JS_EVAL_TYPE_GLOBAL);

	if (JS_IsException(result)) {
		printk("JavaScript execution error\n");
	} else {
		const char *str = JS_ToCString(ctx, result);
		printk("Result: %s\n", str);
		JS_FreeCString(ctx, str);
		JS_FreeValue(ctx, result);
	}

	JS_FreeContext(ctx);
	JS_FreeRuntime(rt);

	printk("QuickJS demo completed\n");

	return 0;
}
```
