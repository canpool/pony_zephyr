## CMakeLists.txt
```
# Copyright (c) 2025 maminjie <canpool@163.com>
# SPDX-License-Identifier: Apache-2.0

cmake_minimum_required(VERSION 3.20.0)

find_package(Zephyr REQUIRED HINTS $ENV{ZEPHYR_BASE})
project(lv_advanced_hello)

target_sources(app PRIVATE src/main.c)
```

## sample.yaml
```
sample:
  description: Hello lv_advanced sample
  name: hello world
common:
  min_ram: 2
  min_flash: 16
  tags: introduction
  integration_platforms:
    - native_sim
  harness: console
  harness_config:
    type: one_line
    regex:
      - "Hello World! (.*)"
tests:
  sample.basic.helloworld:
    tags: introduction
```

## prj.conf
```kconfig
CONFIG_MAIN_STACK_SIZE=4096
CONFIG_LOG=y

CONFIG_LVGL=y
CONFIG_LV_Z_MEM_POOL_SIZE=58368
CONFIG_LV_USE_MONKEY=y

CONFIG_LV_USE_LOG=y
CONFIG_LV_LOG_LEVEL_WARN=y

CONFIG_DISPLAY=y
CONFIG_INPUT=y

CONFIG_LV_FONT_MONTSERRAT_12=y
CONFIG_LV_FONT_MONTSERRAT_14=y
CONFIG_LV_FONT_MONTSERRAT_16=y
CONFIG_LV_FONT_MONTSERRAT_18=y
CONFIG_LV_FONT_MONTSERRAT_24=y

CONFIG_LV_ADVANCED=y
CONFIG_LV_ADV_BUILD_EXAMPLES=y
```

## boards/native_sim_native_64.conf
```kconfig
# Copyright 2023 Fabian Blatz <fabianblatz@gmail.com>
# SPDX-License-Identifier: Apache-2.0

CONFIG_LV_COLOR_DEPTH_16=y
CONFIG_LV_Z_MEM_POOL_SIZE=524288
```

## boards/nucleo_u5a5zj_q.conf
```kconfig
# Copyright 2023 Fabian Blatz <fabianblatz@gmail.com>
# SPDX-License-Identifier: Apache-2.0

CONFIG_LV_Z_MEM_POOL_SIZE=524288
CONFIG_LV_Z_POINTER_INPUT_MSGQ_COUNT=100
CONFIG_INPUT_QUEUE_MAX_MSGS=256

CONFIG_SPI_STM32_DMA=y
CONFIG_SPI_STM32_INTERRUPT=y
```

## boards/stm32u5a9j_dk.conf
```kconfig
CONFIG_MAIN_STACK_SIZE=8192

CONFIG_LV_Z_MEM_POOL_SIZE=589824
CONFIG_LV_Z_POINTER_INPUT_MSGQ_COUNT=100
CONFIG_INPUT_QUEUE_MAX_MSGS=256
```

## boards/native_sim.overlay
```dts
/*
 * Copyright (c) 2023, Fabian Blatz <fabianblatz@gmail.com>
 *
 * SPDX-License-Identifier: Apache-2.0
 */

&sdl_dc {
	compatible = "zephyr,sdl-dc";
	height = <466>;
	width = <466>;
};
```

## src/main.c
```c
/*
 * Copyright (c) 2025 maminjie <canpool@163.com>
 *
 * SPDX-License-Identifier: Apache-2.0
 */

#include <zephyr/kernel.h>
#include <zephyr/drivers/display.h>
#include <lvgl.h>
#include <lvgl_mem.h>
#include <lv_adv.h>
#include <stdio.h>

#define LOG_LEVEL CONFIG_LOG_DEFAULT_LEVEL
#include <zephyr/logging/log.h>
LOG_MODULE_REGISTER(app);

int main(void)
{
	const struct device *display_dev;

	display_dev = DEVICE_DT_GET(DT_CHOSEN(zephyr_display));
	if (!device_is_ready(display_dev)) {
		LOG_ERR("Device not ready, aborting test");
		return 0;
	}
	lv_display_t *disp = lv_display_get_default();
	lv_theme_t *theme =
		lv_theme_default_init(disp, lv_palette_main(LV_PALETTE_BLUE),
				      lv_palette_main(LV_PALETTE_RED), true, LV_FONT_DEFAULT);
	lv_disp_set_theme(disp, theme);

#ifdef CONFIG_BOARD_NATIVE_SIM
	lv_adv_sim_display_set_bg_color(lv_color_white());
#endif

	lv_adv_example_button_1();

	lv_timer_handler();
	display_blanking_off(display_dev);
#ifdef CONFIG_LV_Z_MEM_POOL_SYS_HEAP
	lvgl_print_heap_info(false);
#else
	printf("lvgl in malloc mode\n");
#endif
	while (1) {
#ifdef CONFIG_BOARD_NATIVE_SIM
		lv_adv_sim_screen_set_radius(LV_RADIUS_CIRCLE);
#endif
		uint32_t sleep_ms = lv_timer_handler();

		k_msleep(MIN(sleep_ms, INT32_MAX));
	}

	return 0;
}
```
