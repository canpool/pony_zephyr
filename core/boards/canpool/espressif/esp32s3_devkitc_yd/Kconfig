## core/boards/canpool/espressif/esp32s3_devkitc_yd/Kconfig
```kconfig
# Copyright (c) 2025 maminjie <canpool@163.com>
# SPDX-License-Identifier: Apache-2.0

config HEAP_MEM_POOL_ADD_SIZE_BOARD
	int
	default 4096 if BOARD_ESP32S3_DEVKITC_YD_ESP32S3_PROCPU
	default 256 if BOARD_ESP32S3_DEVKITC_YD_ESP32S3_APPCPU
```

## core/boards/canpool/espressif/esp32s3_devkitc_yd/Kconfig.sysbuild
```kconfig
# Copyright (c) 2025 maminjie <canpool@163.com>
# SPDX-License-Identifier: Apache-2.0

choice BOOTLOADER
	default BOOTLOADER_MCUBOOT
endchoice

choice BOOT_SIGNATURE_TYPE
	default BOOT_SIGNATURE_TYPE_NONE
endchoice
```

## core/boards/canpool/espressif/esp32s3_devkitc_yd/board.yml
```yaml
board:
  name: esp32s3_devkitc_yd
  full_name: YD-ESP32-S3
  vendor: canpool
  socs:
    - name: esp32s3
```

## core/boards/canpool/nordic/nrf52840_e73_2g4m08s1c/Kconfig.nrf52840_e73_2g4m08s1c
```kconfig
# Copyright (c) 2025 maminjie <canpool@163.com>
# SPDX-License-Identifier: Apache-2.0

config BOARD_NRF52840_E73_2G4M08S1C
	select SOC_NRF52840_QIAA
```

## core/boards/canpool/nordic/nrf52840_e73_2g4m08s1c/board.yml
```yaml
board:
  name: nrf52840_e73_2g4m08s1c
  full_name: nRF52840 E73-2G4M08S1C
  vendor: canpool
  socs:
    - name: nrf52840
```

## core/boards/canpool/nordic/nrf52840_supermini/Kconfig.nrf52840_supermini
```kconfig
# Copyright (c) 2025 maminjie <canpool@163.com>
# SPDX-License-Identifier: Apache-2.0

config BOARD_NRF52840_SUPERMINI
	select SOC_NRF52840_QIAA
```

## core/boards/canpool/nordic/nrf52840_supermini/board.yml
```yaml
board:
  name: nrf52840_supermini
  full_name: nRF52840 SuperMini
  vendor: canpool
  socs:
    - name: nrf52840
```

## core/boards/canpool/stm32/stm32f429ig_fire1/Kconfig.stm32f429ig_fire1
```kconfig
# Copyright (c) 2025 maminjie <canpool@163.com>
# SPDX-License-Identifier: Apache-2.0

config BOARD_STM32F429IG_FIRE1
	select SOC_STM32F429XX
```

## core/boards/canpool/stm32/stm32h750vb_eft/Kconfig.defconfig
```kconfig
# STM32H750VB-EFT board configuration

# Copyright (c) 2025 maminjie <canpool@163.com>
# SPDX-License-Identifier: Apache-2.0

if BOARD_STM32H750VB_EFT

config DISK_DRIVER_SDMMC
	default y if DISK_DRIVERS

endif # BOARD_STM32H750VB_EFT
```

## core/boards/canpool/ti/mspm0g3507_yb/Kconfig.mspm0g3507_yb
```kconfig
# Copyright (c) 2025 maminjie <canpool@163.com>
# SPDX-License-Identifier: Apache-2.0

config BOARD_MSPM0G3507_YB
	select SOC_MSPM0G3507
```

## core/west.yml
```yaml
# Copyright (c) 2021 Nordic Semiconductor ASA
# SPDX-License-Identifier: Apache-2.0

manifest:
  self:
    west-commands: scripts/west-commands.yml

  remotes:
    - name: zephyrproject-rtos
      url-base: https://github.com/zephyrproject-rtos
    - name: gitee-mirrors
      url-base: https://gitee.com/mirrors

  projects:
    - name: zephyr
      remote: gitee-mirrors
      revision: v4.2.0-rc1
      import:
        # By using name-allowlist we can clone only the modules that are
        # strictly needed by the application.
        name-allowlist:
          - cmsis_6    # required by the ARM port
          - hal_nordic # required by the custom_plank board (Nordic based)
          - hal_stm32  # required by the nucleo_f302r8 board (STM32 based)
          - hal_ti
          - hal_espressif
          - fatfs
```

## pony/boards/canpool/espressif/esp32s3_devkitc_yd/Kconfig.esp32s3_devkitc_yd
```kconfig
# Copyright (c) 2025 maminjie <canpool@163.com>
# SPDX-License-Identifier: Apache-2.0

config BOARD_ESP32S3_DEVKITC_YD
	select SOC_ESP32S3_WROOM_N16R8
	select SOC_ESP32S3_PROCPU if BOARD_ESP32S3_DEVKITC_YD_ESP32S3_PROCPU
	select SOC_ESP32S3_APPCPU if BOARD_ESP32S3_DEVKITC_YD_ESP32S3_APPCPU
```

## pony/boards/canpool/espressif/esp32s3_touch_amoled_1_75/Kconfig
```kconfig
# Copyright (c) 2025 maminjie <canpool@163.com>
# SPDX-License-Identifier: Apache-2.0

config HEAP_MEM_POOL_ADD_SIZE_BOARD
	int
	default 4096 if BOARD_ESP32S3_TOUCH_AMOLED_1_75_ESP32S3_PROCPU
	default 256 if BOARD_ESP32S3_TOUCH_AMOLED_1_75_ESP32S3_APPCPU
```

## pony/boards/canpool/espressif/esp32s3_touch_amoled_1_75/Kconfig.esp32s3_touch_amoled_1_75
```kconfig
# Copyright (c) 2025 maminjie <canpool@163.com>
# SPDX-License-Identifier: Apache-2.0

config BOARD_ESP32S3_TOUCH_AMOLED_1_75
	select SOC_ESP32S3_WROOM_N16R8
	select SOC_ESP32S3_PROCPU if BOARD_ESP32S3_TOUCH_AMOLED_1_75_ESP32S3_PROCPU
	select SOC_ESP32S3_APPCPU if BOARD_ESP32S3_TOUCH_AMOLED_1_75_ESP32S3_APPCPU
```

## pony/boards/canpool/espressif/esp32s3_touch_amoled_1_75/esp32s3_touch_amoled_1_75_esp32s3_appcpu_defconfig
```kconfig
# Copyright (c) 2025 maminjie <canpool@163.com>
# SPDX-License-Identifier: Apache-2.0

CONFIG_CLOCK_CONTROL=y
```

## pony/boards/canpool/espressif/esp32s3_touch_amoled_1_75/esp32s3_touch_amoled_1_75_esp32s3_procpu_defconfig
```kconfig
# Copyright (c) 2025 maminjie <canpool@163.com>
# SPDX-License-Identifier: Apache-2.0

CONFIG_GPIO=y
CONFIG_REGULATOR=y
CONFIG_CONSOLE=y
CONFIG_SERIAL=y
CONFIG_UART_CONSOLE=y
CONFIG_CLOCK_CONTROL=y
```

## pony/boards/canpool/sifli/sf32lb52_lchspi_ulp/Kconfig.sf32lb52_lchspi_ulp
```kconfig
# Copyright (c) 2026 maminjie <canpool@163.com>
# SPDX-License-Identifier: Apache-2.0

config BOARD_SF32LB52_LCHSPI_ULP
	select SOC_SF32LB525UC6
```

## pony/boards/canpool/sifli/sf32lb52_lchspi_ulp/board.yml
```yaml
# Copyright (c) 2025 Core Devices LLC
# SPDX-License-Identifier: Apache-2.0

board:
  name: sf32lb52_lchspi_ulp
  full_name: LCKFB-HSPI-SF32LB52-ULP
  vendor: lckfb
  socs:
    - name: sf32lb525uc6
```

## pony/boards/canpool/stm32/stm32f429ig_fire1/Kconfig.defconfig
```kconfig
# STM32F429IG-FIRE1 board configuration

# Copyright (c) 2025 maminjie <canpool@163.com>
# SPDX-License-Identifier: Apache-2.0

if BOARD_STM32F429IG_FIRE1

if DISK_DRIVER_SDMMC

config SDMMC_STM32_CLOCK_CHECK
	default n

endif # DISK_DRIVER_SDMMC

endif # BOARD_STM32F429IG_FIRE1
```

## pony/boards/canpool/stm32/stm32f429ig_fire1/board.yml
```yaml
board:
  name: stm32f429ig_fire1
  full_name: STM32F429IG fire tiaozhanzhe V1
  vendor: canpool
  socs:
    - name: stm32f429xx
```

## pony/boards/canpool/stm32/stm32h750vb_eft/Kconfig.stm32h750vb_eft
```kconfig
# STM32H750VB-EFT board configuration

# Copyright (c) 2025 maminjie <canpool@163.com>
# SPDX-License-Identifier: Apache-2.0

config BOARD_STM32H750VB_EFT
	select SOC_STM32H750XX
```

## pony/boards/canpool/stm32/stm32h750vb_eft/board.yml
```yaml
board:
  name: stm32h750vb_eft
  full_name: STM32H750VB-EFT
  vendor: canpool
  socs:
    - name: stm32h750xx
```
