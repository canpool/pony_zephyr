## pony/boards/canpool/ti/mspm0g3507_yb/board.yml
```yaml
board:
  name: mspm0g3507_yb
  full_name: MSPM0G3507 YB-MSA03-V1.0
  vendor: canpool
  socs:
    - name: mspm0g3507
```

## pony/boards/shields/lcdisplay_1_1_tft_touch/Kconfig.defconfig
```kconfig
# Copyright (c) 2025 maminjie <canpool@163.com>
# SPDX-License-Identifier: Apache-2.0

if SHIELD_LCDISPLAY_1_1_TFT_TOUCH

if DISPLAY

if LVGL

config LV_Z_BITS_PER_PIXEL
	default 16

choice LV_COLOR_DEPTH
	default LV_COLOR_DEPTH_16
endchoice

configdefault LV_COLOR_16_SWAP
	default y

config INPUT
	default y

endif # LVGL

endif # DISPLAY

endif # SHIELD_LCDISPLAY_1_1_TFT_TOUCH
```

## pony/boards/shields/lcdisplay_1_1_tft_touch/Kconfig.shield
```kconfig
# Copyright (c) 2025 maminjie <canpool@163.com>
# SPDX-License-Identifier: Apache-2.0

config SHIELD_LCDISPLAY_1_1_TFT_TOUCH
	def_bool $(shields_list_contains,lcdisplay_1_1_tft_touch)
```

## pony/boards/shields/st_mb1835b_lcd_touch/Kconfig.shield
```kconfig
# Copyright (c) 2026 maminjie <canpool@163.com>
# Copyright (c) 2025 Charles Dias
# SPDX-License-Identifier: Apache-2.0

config SHIELD_ST_MB1835B_LCD_TOUCH
	def_bool $(shields_list_contains,st_mb1835b_lcd_touch)
```

## pony/boards/shields/st_mb1835b_lcd_touch/boards/Kconfig.defconfig.stm32u5x
```kconfig
if SOC_SERIES_STM32U5X

if LVGL

config LV_USE_DRAW_DMA2D
	default y

config LV_DRAW_DMA2D_HAL_INCLUDE
	default "stm32u5xx_hal.h"

config STM32_LTDC_FB_NUM
	default 2

config LV_Z_VDB_SIZE
	default 100

config LV_Z_DOUBLE_VDB
	default y

endif # LVGL

endif # SOC_SERIES_STM32U5X
```

## pony/boards/shields/st_mb1835b_lcd_touch/boards/stm32u5a9j_dk.conf
```kconfig
# Heap memory pool configuration
CONFIG_HEAP_MEM_POOL_SIZE=65536

# Display configuration
CONFIG_STM32_LTDC_RGB565=y
```

## pony/drivers/input/Kconfig
```kconfig
# Copyright (c) 2026 maminjie <canpool@163.com>
# SPDX-License-Identifier: Apache-2.0

if INPUT

# zephyr-keep-sorted-start
rsource "Kconfig.st1633i"
# zephyr-keep-sorted-stop

endif # INPUT
```

## pony/drivers/input/Kconfig.st1633i
```kconfig
# Copyright (c) 2026 maminjie <canpool@163.com>
# SPDX-License-Identifier: Apache-2.0

menuconfig INPUT_ST1633I
	bool "ST1633I capacitive touch panel driver"
	default y
	depends on DT_HAS_SITRONIX_ST1633I_ENABLED
	select I2C
	help
	  Enable driver for Sitronix capacitive touch panel
	  controller. This driver should support ST1633I.

if INPUT_ST1633I

config INPUT_ST1633I_INTERRUPT
	bool "Interrupt support"
	default y
	help
	  Enable interrupt support (requires all instances
	  of ST1633I have the INT gpio connected).

config INPUT_ST1633I_PERIOD_MS
	int "Sample period"
	depends on !INPUT_ST1633I_INTERRUPT
	default 10
	help
	  Sample period in milliseconds when in polling mode.

endif # INPUT_ST1633I
```

## pony/dts/bindings/input/sitronix,st1633i.yaml
```yaml
#
# Copyright (c) 2024, Kickmaker
#
# SPDX-License-Identifier: Apache-2.0


description: ST1633i capacitive touch screen controller

compatible: "sitronix,st1633i"

include: i2c-device.yaml

properties:
  int-gpios:
    type: phandle-array
    description: |
      Interrupt GPIO. Used by the controller to signal touch data is
      available. Active low.
```

## pony/west.yml
```yaml
# Copyright (c) 2021 Nordic Semiconductor ASA
# SPDX-License-Identifier: Apache-2.0

manifest:
  self:
    west-commands: scripts/west-commands.yml

  remotes:
    - name: zephyrproject-rtos
      url-base: https://github.com/zephyrproject-rtos
    - name: gitee-mirrors
      url-base: https://gitee.com/mirrors
    - name: canpool
      url-base: https://gitee.com/icanpool

  projects:
    - name: zephyr
      remote: gitee-mirrors
      revision: v4.3.0
      import:
        # By using name-allowlist we can clone only the modules that are
        # strictly needed by the application.
        name-allowlist:
          - cmsis
          - cmsis_6    # required by the ARM port
          - hal_nordic # required by the custom_plank board (Nordic based)
          - hal_stm32  # required by the nucleo_f302r8 board (STM32 based)
          - hal_ti
          - hal_espressif
          - fatfs
          - open-amp
          - libmetal
          - lvgl
    - name: pony_thirdparty_quickjs
      remote: canpool
      revision: master
      path: modules/lib/quickjs
    - name: pony_thirdparty_jerryscript
      remote: canpool
      revision: master
      path: modules/lib/jerryscript
    - name: lv_advanced
      remote: canpool
      revision: master
      path: modules/lib/gui/lv_advanced
```
