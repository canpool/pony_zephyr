/*
 * Copyright (c) 2025 maminjie <canpool@163.com>
 * SPDX-License-Identifier: Apache-2.0
 */

/dts-v1/;
#include <espressif/esp32s3/esp32s3_wroom_n16r8.dtsi>
#include <espressif/partitions_0x0_amp.dtsi>

/ {
	model = "ESP32-S3-Touch-AMOLED-1.75 APPCPU";
	compatible = "waveshare,esp32-s3-touch-amoled-1.75";

	chosen {
		zephyr,sram = &sram1;
		zephyr,ipc_shm = &shm0;
		zephyr,ipc = &ipm0;
		zephyr,flash = &flash0;
		zephyr,code-partition = &slot0_appcpu_partition;
	};
};

&trng0 {
	status = "okay";
};
